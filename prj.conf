## CMakeLists.txt
```
#
# Copyright (c) 2020 Nordic Semiconductor
#
# SPDX-License-Identifier: LicenseRef-BSD-5-Clause-Nordic
#

cmake_minimum_required(VERSION 3.13.1)

set(spm_CONF_FILE ${CMAKE_CURRENT_SOURCE_DIR}/spm.conf)

find_package(Zephyr REQUIRED HINTS $ENV{ZEPHYR_BASE})
project(ifttt_webhook)

target_sources(app PRIVATE src/main.c src/ifttt.c)
```

## Kconfig
```
#
# Copyright (c) 2020 Nordic Semiconductor ASA
#
# SPDX-License-Identifier: LicenseRef-BSD-5-Clause-Nordic
#

menu "IFTTT Sample Settings"

config IFTTT_KEY
	string "IFTTT Key"
	default ""

config IFTTT_EVENT
	string "IFTTT Event"
	default "nRF9160"

endmenu

module = IFTTT
module-str = IFTTT sample
source "${ZEPHYR_BASE}/subsys/logging/Kconfig.template.log_config"

menu "Zephyr Kernel"
source "Kconfig.zephyr"
endmenu
```

## west.yml
```
manifest:
  remotes:
    - name: nordic
      url-base: https://github.com/nrfconnect
  projects:
    - name: sdk-nrf
      path: nrf
      remote: nordic
      revision: master
      import: true
  self:
    path: ifttt_webhook
```

## prj.conf
```kconfig
CONFIG_NEWLIB_LIBC=y
CONFIG_NEWLIB_LIBC_FLOAT_PRINTF=y
CONFIG_NCS_SAMPLES_DEFAULTS=y
CONFIG_SERIAL=y

CONFIG_BSD_LIBRARY=y

CONFIG_NETWORKING=y
CONFIG_NET_NATIVE=n
CONFIG_NET_SOCKETS=y
CONFIG_NET_SOCKETS_OFFLOAD=y

CONFIG_HEAP_MEM_POOL_SIZE=4096
CONFIG_MAIN_STACK_SIZE=4096
CONFIG_SYSTEM_WORKQUEUE_STACK_SIZE=8192

CONFIG_LTE_LINK_CONTROL=y
CONFIG_LTE_AUTO_INIT_AND_CONNECT=n

CONFIG_LTE_PSM_REQ_RPTAU="00100001" # 60 min periodic TAU
CONFIG_LTE_PSM_REQ_RAT="00000101" # 10s active time
#CONFIG_LTE_EDRX_REQ_VALUE="0001" # 10.24s eDRX 
#CONFIG_LTE_PTW_VALUE="0001" # 2.56s PTW

CONFIG_DK_LIBRARY=y
CONFIG_DK_LIBRARY_BUTTON_SCAN_INTERVAL=100
```

## spm.conf
```kconfig
# Configuration copied from the nRF Secure Partition Manager (SPM) sample:
CONFIG_IS_SPM=y
CONFIG_FW_INFO=y
CONFIG_GPIO=y
CONFIG_SERIAL=y
```

## src/main.c
```c
/*
 * Copyright (c) 2020 Nordic Semiconductor ASA
 *
 * SPDX-License-Identifier: LicenseRef-BSD-5-Clause-Nordic
 */

#include <string.h>
#include <zephyr.h>
#include <stdlib.h>
#include <stdio.h>
#include <net/socket.h>
#include <modem/bsdlib.h>
#include <modem/lte_lc.h>
#include <modem/at_cmd.h>
#include <modem/at_notif.h>
#include <modem/modem_key_mgmt.h>
#include <dk_buttons_and_leds.h>
#include "ifttt.h"

#define DATA_FORMAT "{\"value1\":\"%s\",\"value2\":\"%s\",\"value3\":\"%s\"}"
#define VOLTAGE_LEN 4
#define TEMP_LEN 2
#define CLOCK_LEN strlen("18/12/06,22:10:00+08")
#define DATA_LEN (sizeof(DATA_FORMAT) - 6 + VOLTAGE_LEN + TEMP_LEN + CLOCK_LEN)

static struct k_work ifttt_send_work;

static int temp_read(char *buf, size_t buf_len)
{
	int err;
	char at_cmd_buf[64];

	err = at_cmd_write("AT%XTEMP?", at_cmd_buf, sizeof(at_cmd_buf), NULL);
	if (err) {
		printk("ATXTEMP?, error: %d\n", err);
		return err;
	}
	if (!strcmp(at_cmd_buf, "%XTEMP:")) {
		printk("Unexpected response: %s\n", at_cmd_buf);
		return -EINVAL;
	}
	memcpy(buf, &at_cmd_buf[strlen("%XTEMP: ")], TEMP_LEN);
	buf[TEMP_LEN] = 0;
	
	return 0;
}

static int voltage_read(char *buf, size_t buf_len)
{
	int err;
	char at_cmd_buf[64];

	err = at_cmd_write("AT%XVBAT", at_cmd_buf, sizeof(at_cmd_buf), NULL);
	if (err) {
		printk("ATXVBAT, error: %d\n", err);
		return err;
	}
	if (!strcmp(at_cmd_buf, "%XVBAT:")) {
		printk("Unexpected response: %s\n", at_cmd_buf);
		return -EINVAL;
	}
	memcpy(buf, &at_cmd_buf[strlen("%XVBAT: ")], VOLTAGE_LEN);
	buf[VOLTAGE_LEN] = 0;
	
	return 0;
}

static int clock_read(char *buf, size_t buf_len)
{
	int err;
	char at_cmd_buf[64];

	err = at_cmd_write("AT+CCLK?", at_cmd_buf, sizeof(at_cmd_buf), NULL);
	if (err) {
		printk("AT+CCLK?, error: %d\n", err);
		return err;
	}
	if (!strcmp(at_cmd_buf, "+CCLK:")) {
		printk("Unexpected response: %s\n", at_cmd_buf);
		return -EINVAL;
	}
	memcpy(buf, &at_cmd_buf[strlen("+CCLK: \"")], CLOCK_LEN);
	buf[CLOCK_LEN] = 0;

	return 0;
}

static void ifttt_send_work_fn(struct k_work *work)
{
	int err;
	char temp_str[TEMP_LEN + 1];
	char voltage_str[VOLTAGE_LEN + 1];
	char clock_str[CLOCK_LEN + 1];
	char data_str[DATA_LEN];

	NRF_UARTE0_NS->ENABLE = 8;
	printk("ifttt_send_work_fn\n");

	err = temp_read(temp_str, sizeof(temp_str));
	if (err) {
		printk("temp_read, error: %d\n", err);
		goto cleanup;
	}

	err = voltage_read(voltage_str, sizeof(voltage_str));
	if (err) {
		printk("voltage_read, error: %d\n", err);
		goto cleanup;
	}

	err = clock_read(clock_str, sizeof(clock_str));
	if (err) {
		printk("clock_read, error: %d\n", err);
		goto cleanup;
	}

	sprintf(data_str, DATA_FORMAT, temp_str, voltage_str, clock_str);
	printk("data=%s\n", data_str);

	struct ifttt_data data = {
		.event = CONFIG_IFTTT_EVENT,
		.key = CONFIG_IFTTT_KEY,
		.data = data_str
	};

	err = ifttt_send(&data);
	if (err) {
		printk("ifttt_send, error: %d\n", err);
	}

cleanup:
	printk("ifttt_send_work_fn exit\n");
	NRF_UARTE0_NS->ENABLE = 0;
}

/**@brief Callback for button events from the DK buttons and LEDs library. */
static void button_handler(uint32_t button_states, uint32_t has_changed)
{
	uint8_t btn_num;

	while (has_changed) {
		btn_num = 0;

		/* Get bit position for next button that changed state. */
		for (uint8_t i = 0; i < 32; i++) {
			if (has_changed & BIT(i)) {
				btn_num = i + 1;
				break;
			}
		}

		/* Button number has been stored, remove from bitmask. */
		has_changed &= ~(1UL << (btn_num - 1));

		if((btn_num == 1) && (button_states & BIT(btn_num - 1))) {
			k_work_submit(&ifttt_send_work);
		}
	}
}

int lte_psm_edrx_config(void)
{
	int err;

	/** eDRX and PTW config */
	/*err = lte_lc_edrx_req(true);
	if (err) {
		printk("lte_lc_edrx_req, error: %d\n", err);
		return err;
	}*/
	/** Power Saving Mode */
	err = lte_lc_psm_req(true);
	if (err) {
		printk("lte_lc_psm_req, error: %d\n", err);
		return err;
	}

	return 0;
}

void main(void)
{
	int err;

	/* Stop the UART RX for power consumption reasons */
    NRF_UARTE0_NS->TASKS_STOPRX = 1;
	NRF_UARTE1_NS->TASKS_STOPRX = 1;

	printk("IFTTT webhook sample started\n\r");

	k_work_init(&ifttt_send_work, ifttt_send_work_fn);

	err = dk_buttons_init(button_handler);
	if (err) {
		printk("Failed to initialize buttons, err code: %d\n",	err);
		return;
	}

	err = lte_psm_edrx_config();
	if (err) {
		printk("Failed to configure PSM and eDRX!\n");
		return;
	}

	printk("Waiting for network.. ");
	err = lte_lc_init_and_connect();
	if (err) {
		printk("Failed to connect to the LTE network, err %d\n", err);
		return;
	}

	err = lte_psm_edrx_config();
	if (err) {
		printk("Failed to configure PSM and eDRX!\n");
		return;
	}

	printk("OK\n");

	NRF_UARTE0_NS->ENABLE = 0;
	NRF_UARTE1_NS->ENABLE = 0;
}
```

## src/ifttt.c
```c
/*
 * Copyright (c) 2020 Nordic Semiconductor ASA
 *
 * SPDX-License-Identifier: LicenseRef-BSD-5-Clause-Nordic
 */

#include <string.h>
#include <zephyr.h>
#include <stdlib.h>
#include <stdio.h>
#include <net/socket.h>
#include <modem/bsdlib.h>
#include <modem/lte_lc.h>
#include <modem/at_cmd.h>
#include <modem/at_notif.h>
#include <modem/modem_key_mgmt.h>
#include "ifttt.h"

#define HTTP_PORT 80

#define __HTTP_HEAD                                                          \
	"POST /trigger/" IFTTT_EVENT "/with/key/" IFTTT_KEY " HTTP/1.1\r\n"    \
	"Host: maker.ifttt.com\r\n"                                            \
	"Content-Type: application/json\r\n"                                   \
	"Content-Length: " IFTTT_DATA_LEN "\r\n\r\n"                           \
	IFTTT_DATA "\r\n"

#define HTTP_HEAD                                                          \
	"POST /trigger/%s/with/key/%s HTTP/1.1\r\n"                            \
	"Host: maker.ifttt.com\r\n"                                            \
	"Content-Type: application/json\r\n"                                   \
	"Content-Length: %d\r\n\r\n"                                           \
	"%s\r\n"

#define RECV_BUF_SIZE 1024

#define HTTP_REQ_LEN(x) \
	(strlen(HTTP_HEAD) - 8 + strlen(x->event) + strlen(x->key) + strlen(x->data) + 2)

static int build_http_request(char *req, struct ifttt_data *data)
{
	return sprintf(req, HTTP_HEAD, data->event, data->key, strlen(data->data), data->data);
}

int ifttt_send(struct ifttt_data *data)
{
	int err;
	int fd;
	char *p;
	int bytes;
	size_t off;
	struct addrinfo *res;
	struct addrinfo hints = {
		.ai_family = AF_INET,
		.ai_socktype = SOCK_STREAM,
	};

	char send_buf[HTTP_REQ_LEN(data)];
	char recv_buf[RECV_BUF_SIZE];

	int len = build_http_request(send_buf, data);
	if (len != HTTP_REQ_LEN(data)) {
		printk("build_http_request() failed, %d != %d\r\n%s", len, HTTP_REQ_LEN(data), send_buf);
		return -EINVAL;
	}

	err = getaddrinfo("maker.ifttt.com", NULL, &hints, &res);
	if (err) {
		printk("getaddrinfo() failed, err %d\n", errno);
		return -EHOSTUNREACH;
	}

	((struct sockaddr_in *)res->ai_addr)->sin_port = htons(HTTP_PORT);

	fd = socket(AF_INET, SOCK_STREAM, IPPROTO_TCP);
	if (fd == -1) {
		printk("Failed to open socket!\n");
		goto clean_up;
	}

	printk("Connecting to %s\n", "maker.ifttt.com");
	err = connect(fd, res->ai_addr, sizeof(struct sockaddr_in));
	if (err) {
		printk("connect() failed, err: %d\n", errno);
		goto clean_up;
	}

	off = 0;
	do {
		bytes = send(fd, &send_buf[off], HTTP_REQ_LEN(data) - off, 0);
		if (bytes < 0) {
			printk("send() failed, err %d\n", errno);
            err = -EINVAL;
			goto clean_up;
		}
		off += bytes;
	} while (off < HTTP_REQ_LEN(data));

	printk("Sent %d bytes\n", off);

	off = 0;
	do {
		bytes = recv(fd, &recv_buf[off], RECV_BUF_SIZE - off, 0);
		if (bytes < 0) {
			printk("recv() failed, err %d\n", errno);
            err = -EINVAL;
			goto clean_up;
		}
		off += bytes;
	} while (bytes != 0 /* peer closed connection */);

	printk("Received %d bytes\n", off);

	/* Print HTTP response */
	p = strstr(recv_buf, "\r\n");
	if (p) {
		off = p - recv_buf;
		recv_buf[off + 1] = '\0';
		printk("\n>\t %s\n\n", recv_buf);
        if (!strcmp(recv_buf, "HTTP/1.1 200 OK")) {
            printk("Respose not expected!\n");
            err = -EINVAL;
            goto clean_up;
        }
	} else {
		printk("%s", recv_buf);
        err = -EINVAL;
        goto clean_up;
    }

	printk("Finished, closing socket.\n");

clean_up:
	freeaddrinfo(res);
	(void)close(fd);

    return err;
}
```

## src/ifttt.h
```c
/*
 * Copyright (c) 2020 Nordic Semiconductor ASA
 *
 * SPDX-License-Identifier: LicenseRef-BSD-5-Clause-Nordic
 */
/**@file
 *
 * @defgroup ifttt IFTTT webhooks
 * @brief  Module to send HTTP POST to IFTTT webhooks service
 * @{
 */

#ifndef IFTTT_H__
#define IFTTT_H__

#ifdef __cplusplus
extern "C" {
#endif

struct ifttt_data {
    char *event;
    char *key;
    char *data;
};

/**
 * @brief Send data to IFTTT.
 *
 * @param data Pointer to the data
 *
 * @return 0 if the operation was successful, otherwise a (negative) error code.
 */
int ifttt_send(struct ifttt_data *data);

/**
 * @}
 */
#ifdef __cplusplus
}
#endif

#endif /* IFTTT_H__ */
```
